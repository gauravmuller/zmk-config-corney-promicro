## boards/shields/corney_promicro/Kconfig.defconfig
```kconfig
if SHIELD_CORNEY_PROMICRO_DONGLE

    config ZMK_KEYBOARD_NAME
        default "Corney ProMicro"

    config ZMK_SPLIT_BLE_ROLE_CENTRAL
        default y

    config ZMK_USB
        default y
endif # 

if SHIELD_CORNEY_PROMICRO_LEFT || SHIELD_CORNEY_PROMICRO_RIGHT || SHIELD_CORNEY_PROMICRO_DONGLE

    config ZMK_SPLIT
        default y

    config ZMK_BLE
        default y

endif
```

## boards/shields/corney_promicro/Kconfig.shield
```kconfig
config SHIELD_CORNEY_PROMICRO_LEFT
    def_bool $(shields_list_contains,corney_promicro_left)

config SHIELD_CORNEY_PROMICRO_RIGHT
    def_bool $(shields_list_contains,corney_promicro_right)

config SHIELD_CORNEY_PROMICRO_DONGLE
    def_bool $(shields_list_contains,corney_promicro_dongle)
```
